// ***** CTESP CyberSecurity *****
// ******* Weather Station *******
// ******** VERSION 1.0.0 ********
// ** Created and Developed by: **
// ****** Ricardo Oliveira *******
// ******** Diogo Pereira ********
// ********* Tiago Pinto *********
// ******* Fabiano Almeida *******
// Libraries
#include <WiFi.h>
#include <Wire.h>
#include <Adafruit_GFX.h>
#include <Adafruit_SSD1306.h>
#include <ESPAsyncWebServer.h>
#include <AsyncTCP.h>
#include <DHT.h>
// OLED Display Dimensions
#define SCREEN_WIDTH 128
#define SCREEN_HEIGHT 64
// OLED, Sensors and Global Variables Setup
Adafruit_SSD1306 display(SCREEN_WIDTH, SCREEN_HEIGHT, &Wire, -1);
#define DHTTYPE DHT11
const int powerButtonPin = 5;
const int motionSensorPin = 23;
const int dhtSensorPin = 19;
const int ledOnPin = 15;
const int ledOffPin = 4;
DHT dht(dhtSensorPin, DHT11);
bool systemOn = false;
// WiFi AP Credentials
const char* ssid = "WeatherStation";
const char* password = "Weather1234";
// Web Server Port 80
AsyncWebServer server(80);
AsyncWebSocket ws("/ws");
// Web Server Code
const char index_html[] PROGMEM = R"rawliteral(
<!DOCTYPE html>
<html lang="en">
<head>
<meta charset="UTF-8" />
<meta name="viewport" content="width=device-width, initial-scale=1.0"/>
<title>Weather Station Dashboard</title>
<style>
body {
font-family: Arial, sans-serif;
background: #121212;
color: #fff;
display: flex;
flex-direction: column;
align-items: center;
padding: 20px;
}
h1 {
margin-bottom: 20px;
}
.card {
background: #1e1e1e;
padding: 20px;
border-radius: 12px;
box-shadow: 0 0 10px rgba(0,0,0,0.3);
margin: 10px;
text-align: center;
width: 250px;
}
.value {
font-size: 2.5em;
font-weight: bold;
}
.label {
font-size: 1em;
color: #aaa;
}
.container {
display: flex;
gap: 20px;
flex-wrap: wrap;
justify-content: center;
}
</style>
</head>
<body>
<h1>🌤 Weather Station</h1>
<div class="container">
<div class="card">
<div class="value" id="temp">-- °C</div>
<div class="label">Temperature</div>
</div>
<div class="card">
<div class="value" id="hum">-- %</div>
<div class="label">Humidity</div>
</div>
</div>
<script>
const ws = new WebSocket(`ws://${location.host}/ws`);
ws.onmessage = event => {
const data = JSON.parse(event.data);
document.getElementById("temp").textContent = `${data.temp} °C`;
document.getElementById("hum").textContent = `${data.hum} %`;
};
ws.onopen = () => console.log("WebSocket connected");
ws.onclose = () => console.log("WebSocket disconnected");
</script>
</body>
</html>
)rawliteral";
// Bitmap WeatherStation Logo
const unsigned char weatherStationLogoBitmap [] PROGMEM = {
0x00, 0x00, 0x00, 0x00, 0x00, 0x00, 0x00, 0x00, 0x00, 0x00, 0x00, 0x00, 0x00, 0x00, 0x00, 0x00,
0x00, 0x00, 0x00, 0x00, 0x00, 0x00, 0x00, 0x00, 0x00, 0x00, 0x00, 0x00, 0x00, 0x00, 0x00, 0x00,
0x00, 0x00, 0x00, 0x00, 0x00, 0x00, 0x00, 0x00, 0x00, 0x00, 0x00, 0x00, 0x00, 0x00, 0x00, 0x00,
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0x00, 0x00, 0x00, 0x00, 0x00, 0x00, 0x00, 0x00, 0x00, 0x00, 0x00, 0x00, 0x00, 0x00, 0x00, 0x00
};
// Bitmap 16x16 Motion Alert Icon
const unsigned char motionIcon[] PROGMEM = {
0x00, 0x00,
0x00, 0x00,
0x01, 0x80,
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0x00, 0x00
};
// Bitmap 16x16 Thermometer Icon
const unsigned char thermometerIcon[] PROGMEM = {
0x01, 0xC0,
0x03, 0xE0,
0x07, 0x20,
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0x07, 0xE0
};
// Bitmap 8x8 Degree Symbol
const unsigned char degreeSymbol[] PROGMEM = {
0x38, 0x44, 0x44, 0x38, 0x00, 0x00, 0x00, 0x00
};
// Bitmap 16x16 Humidity Icon
const unsigned char humidityIcon[] PROGMEM = {
0x00, 0x00, 0x01, 0x80, 0x03, 0xC0, 0x07, 0xE0,
0x0F, 0xF0, 0x0F, 0xF0, 0x1F, 0xF8, 0x1F, 0xD8,
0x3F, 0x9C, 0x3F, 0x9C, 0x3F, 0x1C, 0x1E, 0x38,
0x1F, 0xF8, 0x0F, 0xF0, 0x03, 0xC0, 0x00, 0x00
};
// Bitmap 16x16 Error Triangle Icon
const unsigned char errorIcon[] PROGMEM = {
0x00, 0x80,
0x01, 0xC0,
0x01, 0xC0,
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0x00, 0x00
};
// Setup Function (Main)
void setup() {
Serial.begin(115200);
if(!display.begin(SSD1306_SWITCHCAPVCC, 0x3C)) { // Address 0x3D for 128x64
Serial.println(F("OLED Display failed"));
for(;;);
}
configPin();
initialize();
}
// Main Loop
void loop() {
powerState();
if (systemOn) {
static unsigned long lastDHTRead = 0;
static int lastMotionState = LOW;
unsigned long now = millis();
// Check motion every loop iteration
int currentMotionState = digitalRead(motionSensorPin);
if (currentMotionState != lastMotionState) {
if (currentMotionState == HIGH) {
motionDetected(); // Motion started
delay(10000);
} else {
noMotionDetected(); // Motion stopped
}
lastMotionState = currentMotionState;
}
// Read and send DHT data every 2 seconds
if (now - lastDHTRead >= 2000) {
float temperature = dht.readTemperature();
float humidity = dht.readHumidity();
if (!isnan(temperature) && !isnan(humidity)) {
notifyClients(temperature, humidity);
}
lastDHTRead = now;
}
}
}
// Helper Functions for Text in Display
struct TextPosition {
int x;
int y;
};
TextPosition getCenteredXY(const String &text, int textSize = 1, int displayWidth = 128, int displayHeight =
64) {
int16_t x1, y1;
uint16_t w, h;
display.setTextSize(textSize);
display.getTextBounds(text, 0, 0, &x1, &y1, &w, &h);
int x = (displayWidth - w) / 2;
int y = (displayHeight - h) / 2;
return {x, y};
}
void drawDegreeSymbol(int x, int y) {
display.drawBitmap(x, y, degreeSymbol, 8, 8, SSD1306_WHITE);
}
void printTypingEffect(const String &text, int x, int y, int textSize = 1, int delayMs = 100, bool
clearDisplayFirst = false, bool isTemp = false) {
display.setTextSize(textSize);
display.setTextColor(SSD1306_WHITE);
if (clearDisplayFirst) {
display.clearDisplay();
}
display.setCursor(x, y);
for (int i = 0; i < text.length(); i++) {
if (text[i] == '°') { // Handle degree symbol
drawDegreeSymbol(display.getCursorX(), y);
display.setCursor(display.getCursorX() + 10, y); // Move cursor past symbol
} else {
display.print(text[i]);
}
display.display();
delay(delayMs);
}
if (isTemp) {
drawDegreeSymbol(display.getCursorX(), y);
display.setCursor(display.getCursorX() + 10, y);
display.print("C");
display.display();
}
}
// Function to Configure Pins
void configPin() {
pinMode(powerButtonPin, INPUT_PULLUP);
pinMode(motionSensorPin, INPUT);
pinMode(ledOnPin, OUTPUT);
pinMode(ledOffPin, OUTPUT);
digitalWrite(ledOnPin, LOW);
digitalWrite(ledOffPin, LOW);
dht.begin();
}
// Function to Initialize and Warm-UP Sensors
void initialize() {
Serial.println("Starting...");
TextPosition posStart = getCenteredXY("Starting...", 1);
printTypingEffect("Starting...", posStart.x, posStart.y, 1, 150, true);
delay(20000);
configWiFi();
Serial.println("Warming Up...");
TextPosition posWarm = getCenteredXY("Warming Up...", 1);
printTypingEffect("Warming Up...", posWarm.x, posWarm.y, 1, 150, true);
delay(40000);
Serial.println("Ready!");
TextPosition posReady = getCenteredXY("Ready!", 1);
printTypingEffect("Ready!", posReady.x, posReady.y, 1, 150, true);
delay(2000);
}
// Function to Configure WiFi
void configWiFi () {
if (WiFi.softAP(ssid, password)) {
Serial.println("AP WiFi Started! Ready to Receive Connections...");
} else {
Serial.println("Failed to Start AP WiFi");
}
}
// Function to Start the System with Button
void powerState() {
static int lastState = HIGH;
static bool firstRun = true;
int currentState = digitalRead(powerButtonPin);
if (firstRun) {
currentState = LOW;
}
if (lastState == HIGH && currentState == LOW) {
systemOn = !systemOn;
if (systemOn) {
digitalWrite(ledOnPin, HIGH);
digitalWrite(ledOffPin, LOW);
Serial.println("System Online");
startWebServer();
String systemOnText = "System Online";
TextPosition posSystemOn = getCenteredXY(systemOnText, 1);
printTypingEffect(systemOnText, posSystemOn.x, posSystemOn.y, 1, 100, true);
delay(2000);
weatherStationLogo();
} else {
digitalWrite(ledOnPin, LOW);
digitalWrite(ledOffPin, HIGH);
stopWebServer();
Serial.println("System Offline");
String systemOffText = "System Offline";
TextPosition posSystemOff = getCenteredXY(systemOffText, 1);
printTypingEffect(systemOffText, posSystemOff.x, posSystemOff.y, 1, 100, true);
}
}
lastState = currentState;
firstRun = false;
}
// Function to Start and Configure WebServer
void startWebServer () {
ws.onEvent(onWsEvent);
server.addHandler(&ws);
server.on("/", HTTP_GET, [](AsyncWebServerRequest *request) {
request->send_P(200, "text/html", index_html);
});
server.begin();
Serial.println("WebServer Started! Ready to Receive Connections...");
Serial.println("Access this IP:" );
Serial.println(WiFi.softAPIP());
}
// Event Handler to Keep WebSocket Alive
void onWsEvent(AsyncWebSocket *server, AsyncWebSocketClient *client, AwsEventType type,
void *arg, uint8_t *data, size_t len) {
}
// Function to Send Sensor Data to Web Server
void notifyClients(float temperature, float humidity) {
char json[64];
snprintf(json, sizeof(json), "{\"temp\":%.1f,\"hum\":%.1f}", temperature, humidity);
ws.textAll(json);
}
// Function to Stop WebServer
void stopWebServer() {
ws.closeAll();
server.end();
Serial.println("WebServer Stopped!");
}
void weatherStationLogo() {
for (int y = -64; y <= 0; y += 4) {
display.clearDisplay();
display.drawBitmap(0, y, weatherStationLogoBitmap, 128, 64, SSD1306_WHITE);
display.display();
delay(30);
}
display.clearDisplay();
display.drawBitmap(0, 0, weatherStationLogoBitmap, 128, 64, SSD1306_WHITE);
display.display();
}
// Function Triggered when Motion Detected
void motionDetected() {
Serial.println("Motion detected!");
float temperature = dht.readTemperature();
float humidity = dht.readHumidity();
display.clearDisplay(); // Clear once at the start
// Draw static icons and line
display.drawBitmap(0, 0, motionIcon, 16, 16, SSD1306_WHITE);
display.drawBitmap(112, 0, motionIcon, 16, 16, SSD1306_WHITE);
display.drawLine(0, 18, 128, 18, SSD1306_WHITE);
String motionText = "Motion Detected";
printTypingEffect(motionText, 16, 8, 1, 100, false);
if (!isnan(temperature) && !isnan(humidity)) {
// Draw temperature icons
display.drawBitmap(0, 24, thermometerIcon, 16, 16, SSD1306_WHITE);
display.drawBitmap(112, 24, thermometerIcon, 16, 16, SSD1306_WHITE);
// Draw humidity icons
display.drawBitmap(0, 48, humidityIcon, 16, 16, SSD1306_WHITE);
display.drawBitmap(112, 48, humidityIcon, 16, 16, SSD1306_WHITE);
// Animate temperature text
String tempText = String(temperature, 1);
TextPosition posTemp = getCenteredXY(tempText + "°C", 1);
printTypingEffect(tempText, posTemp.x, 30, 1, 100, false, true);
// Animate humidity text
String humText = String(humidity, 1) + " %";
TextPosition posHum = getCenteredXY(humText, 1);
printTypingEffect(humText, posHum.x, 54, 1, 100, false);
} else {
Serial.println("Failed to read data from DHT sensor!");
// Draw error icons
display.drawBitmap(0, 32, errorIcon, 16, 16, SSD1306_WHITE);
display.drawBitmap(112, 32, errorIcon, 16, 16, SSD1306_WHITE);
// Animate error text
String errorText = "DHT11 Error...";
TextPosition posErr = getCenteredXY(errorText, 1);
printTypingEffect(errorText, posErr.x, 38, 1, 100, false);
}
}
// Function Triggered when no Motion Detected
void noMotionDetected() {
display.clearDisplay();
weatherStationLogo();
Serial.println("Waiting for motion...");
}
